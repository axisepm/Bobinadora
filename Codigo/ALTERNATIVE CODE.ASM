
; PICBASIC PRO(TM) Compiler 3.0.6.1, (c) 1998, 2012 microEngineering Labs, Inc. All Rights Reserved. 
MPASMX_USED			EQU	1

#define	PBP_PATH	C:\PBP3\




        NOLIST
    ifdef PM_USED
        LIST
        include 'M16F8x.INC'    ; PM header
        XALL
        NOLIST
    else
        LIST
        LIST p = 16F84A, r = dec, w = -302
        INCLUDE "P16F84A.INC"    ; MPASM  Header
        NOLIST
    endif
        LIST


PBP_HARDWAREDEF  macro
  endm


    ifdef PM_USED
        device  pic16F84A, xt_osc, wdt_on, protect_off
    else
        __config _XT_OSC & _WDT_ON & _CP_OFF
    endif



; Define statements.
; C:\USERS\SSIMONE\DOCUMENTS\GITHUB\BOBINADORA\CODIGO\ALTERNATIVE CODE.PBP	00016	define LCD_DREG     PORTB  'definimos que puerto vamos a usar para el LCD
#define		LCD_DREG		     PORTB  
; C:\USERS\SSIMONE\DOCUMENTS\GITHUB\BOBINADORA\CODIGO\ALTERNATIVE CODE.PBP	00017	DEFINE LCD_DBIT     0      'A partir de que pin
#define		LCD_DBIT		     0      
; C:\USERS\SSIMONE\DOCUMENTS\GITHUB\BOBINADORA\CODIGO\ALTERNATIVE CODE.PBP	00018	DEFINE LCD_RSREG    PORTA  'Definimos en que puerto esta el RS
#define		LCD_RSREG		    PORTA  
; C:\USERS\SSIMONE\DOCUMENTS\GITHUB\BOBINADORA\CODIGO\ALTERNATIVE CODE.PBP	00019	DEFINE LCD_RSBIT    2      'RA2
#define		LCD_RSBIT		    2      
; C:\USERS\SSIMONE\DOCUMENTS\GITHUB\BOBINADORA\CODIGO\ALTERNATIVE CODE.PBP	00020	DEFINE LCD_EREG     PORTA  'Definimos en que puerto esta el E
#define		LCD_EREG		     PORTA  
; C:\USERS\SSIMONE\DOCUMENTS\GITHUB\BOBINADORA\CODIGO\ALTERNATIVE CODE.PBP	00021	DEFINE LCD_EBIT     3      'RA3                                                                      
#define		LCD_EBIT		     3      

RAM_START       		EQU	0000Ch
RAM_END         		EQU	0004Fh
RAM_BANKS       		EQU	00001h
BANK0_START     		EQU	0000Ch
BANK0_END       		EQU	0004Fh
EEPROM_START    		EQU	02100h
EEPROM_END      		EQU	0213Fh

; C:\PBP3\PBPPIC14.RAM     	00012	A0000C	R0      VAR     WORD BANK0 SYSTEM       ' System Register
R0              		EQU	RAM_START + 000h
; C:\PBP3\PBPPIC14.RAM     	00013	A0000E	R1      VAR     WORD BANK0 SYSTEM       ' System Register
R1              		EQU	RAM_START + 002h
; C:\PBP3\PBPPIC14.RAM     	00014	A00010	R2      VAR     WORD BANK0 SYSTEM       ' System Register
R2              		EQU	RAM_START + 004h
; C:\PBP3\PBPPIC14.RAM     	00015	A00012	R3      VAR     WORD BANK0 SYSTEM       ' System Register
R3              		EQU	RAM_START + 006h
; C:\PBP3\PBPPIC14.RAM     	00016	A00014	R4      VAR     WORD BANK0 SYSTEM       ' System Register
R4              		EQU	RAM_START + 008h
; C:\PBP3\PBPPIC14.RAM     	00017	A00016	R5      VAR     WORD BANK0 SYSTEM       ' System Register
R5              		EQU	RAM_START + 00Ah
; C:\PBP3\PBPPIC14.RAM     	00018	A00018	R6      VAR     WORD BANK0 SYSTEM       ' System Register
R6              		EQU	RAM_START + 00Ch
; C:\PBP3\PBPPIC14.RAM     	00019	A0001A	R7      VAR     WORD BANK0 SYSTEM       ' System Register
R7              		EQU	RAM_START + 00Eh
; C:\PBP3\PBPPIC14.RAM     	00020	A0001C	R8      VAR     WORD BANK0 SYSTEM       ' System Register
R8              		EQU	RAM_START + 010h
; C:\PBP3\PBPPIC14.RAM     	00026	A0001E	FLAGS   VAR     BYTE BANK0 SYSTEM       ' Static flags
FLAGS           		EQU	RAM_START + 012h
; C:\PBP3\PBPPIC14.RAM     	00025	A0001F	GOP     VAR     BYTE BANK0 SYSTEM       ' Gen Op Parameter
GOP             		EQU	RAM_START + 013h
; C:\PBP3\PBPPIC14.RAM     	00022	A00020	RM1     VAR     BYTE BANK0 SYSTEM       ' Pin 1 Mask
RM1             		EQU	RAM_START + 014h
; C:\PBP3\PBPPIC14.RAM     	00024	A00021	RM2     VAR     BYTE BANK0 SYSTEM       ' Pin 2 Mask
RM2             		EQU	RAM_START + 015h
; C:\PBP3\PBPPIC14.RAM     	00021	A00022	RR1     VAR     BYTE BANK0 SYSTEM       ' Pin 1 Register
RR1             		EQU	RAM_START + 016h
; C:\PBP3\PBPPIC14.RAM     	00023	A00023	RR2     VAR     BYTE BANK0 SYSTEM       ' Pin 2 Register
RR2             		EQU	RAM_START + 017h
; C:\USERS\SSIMONE\DOCUMENTS\GITHUB\BOBINADORA\CODIGO\ALTERNATIVE CODE.PBP	00022	A00024	conteo var word     'Armamos la variable conteo. Esta variable la vamos a cortar en dos y la vamos a copiar a la EEPROM
_conteo          		EQU	RAM_START + 018h
; C:\USERS\SSIMONE\DOCUMENTS\GITHUB\BOBINADORA\CODIGO\ALTERNATIVE CODE.PBP	00033	A00026	flash_lcd var byte  'Variable para flashear LCD
_flash_lcd       		EQU	RAM_START + 01Ah
; C:\USERS\SSIMONE\DOCUMENTS\GITHUB\BOBINADORA\CODIGO\ALTERNATIVE CODE.PBP	00001	A00027	'****************************************************************
PB01            		EQU	RAM_START + 01Bh
; C:\PBP3\DEVICES\PIC16F84A.PBPINC	00110	PORTL   VAR     PORTB
_PORTL           		EQU	 PORTB
; C:\PBP3\DEVICES\PIC16F84A.PBPINC	00111	PORTH   VAR     PORTA
_PORTH           		EQU	 PORTA
; C:\PBP3\DEVICES\PIC16F84A.PBPINC	00112	TRISL   VAR     TRISB
_TRISL           		EQU	 TRISB
; C:\PBP3\DEVICES\PIC16F84A.PBPINC	00113	TRISH   VAR     TRISA
_TRISH           		EQU	 TRISA
_conteo??BYTE0   		EQU	_conteo
_conteo??BYTE1   		EQU	_conteo + 001h
#define _ongoing         	 PB01, 002h
#define _flagpulso       	 PB01, 000h
#define _halt            	 PB01, 001h
#define _stopped         	 PB01, 003h
#define _pulsos          	_PORTB??4
#define _relay           	_PORTB??5
#define _start           	_PORTB??6
#define _pausa           	_PORTB??7
#define _parar           	_PORTA??0
#define _PORTB??4        	 PORTB, 004h
#define _PORTB??5        	 PORTB, 005h
#define _PORTB??6        	 PORTB, 006h
#define _PORTB??7        	 PORTB, 007h
#define _PORTA??0        	 PORTA, 000h
	INCLUDE	"ALTERNATIVE CODE.MAC"
	INCLUDE	"C:\PBP3\PBPPIC14.LIB"


; C:\PBP3\DEVICES\PIC16F84A.PBPINC	00036	#HEADER
; C:\PBP3\DEVICES\PIC16F84A.PBPINC	00061	#CONFIG
; C:\PBP3\DEVICES\PIC16F84A.PBPINC	00103	BANK0   $000C, $004F
; C:\PBP3\DEVICES\PIC16F84A.PBPINC	00105	EEPROM  $2100, $213F
; C:\PBP3\DEVICES\PIC16F84A.PBPINC	00107	    #ERROR "-n option (PBPL) is not supported for this device."
; C:\PBP3\DEVICES\PIC16F84A.PBPINC	00108	#ENDIF
; C:\PBP3\DEVICES\PIC16F84A.PBPINC	00109	LIBRARY "PBPPIC14"

; C:\PBP3\DEVICES\PIC16F84A.PBPINC	00114	include "PBPPIC14.RAM"
; C:\PBP3\DEVICES\PIC16F84A.PBPINC	00118	#HEADER

; C:\USERS\SSIMONE\DOCUMENTS\GITHUB\BOBINADORA\CODIGO\ALTERNATIVE CODE.PBP	00015	variables:

	LABEL?L	_variables	
; C:\USERS\SSIMONE\DOCUMENTS\GITHUB\BOBINADORA\CODIGO\ALTERNATIVE CODE.PBP	00016	define LCD_DREG     PORTB  'definimos que puerto vamos a usar para el LCD
; C:\USERS\SSIMONE\DOCUMENTS\GITHUB\BOBINADORA\CODIGO\ALTERNATIVE CODE.PBP	00017	DEFINE LCD_DBIT     0      'A partir de que pin
; C:\USERS\SSIMONE\DOCUMENTS\GITHUB\BOBINADORA\CODIGO\ALTERNATIVE CODE.PBP	00018	DEFINE LCD_RSREG    PORTA  'Definimos en que puerto esta el RS
; C:\USERS\SSIMONE\DOCUMENTS\GITHUB\BOBINADORA\CODIGO\ALTERNATIVE CODE.PBP	00019	DEFINE LCD_RSBIT    2      'RA2
; C:\USERS\SSIMONE\DOCUMENTS\GITHUB\BOBINADORA\CODIGO\ALTERNATIVE CODE.PBP	00020	DEFINE LCD_EREG     PORTA  'Definimos en que puerto esta el E
; C:\USERS\SSIMONE\DOCUMENTS\GITHUB\BOBINADORA\CODIGO\ALTERNATIVE CODE.PBP	00021	DEFINE LCD_EBIT     3      'RA3                                                                      

; C:\USERS\SSIMONE\DOCUMENTS\GITHUB\BOBINADORA\CODIGO\ALTERNATIVE CODE.PBP	00034	TRISB=%11010000     'Todos los pines son salidas. RA2,RA3,RA4 son por ahora las entradas.(PORTA)
	MOVE?CB	0D0h, TRISB

; C:\USERS\SSIMONE\DOCUMENTS\GITHUB\BOBINADORA\CODIGO\ALTERNATIVE CODE.PBP	00035	TRISA=%00010011     'Todos los pines son salidas (PORTB) 
	MOVE?CB	013h, TRISA

; C:\USERS\SSIMONE\DOCUMENTS\GITHUB\BOBINADORA\CODIGO\ALTERNATIVE CODE.PBP	00036	pause 200
	PAUSE?C	0C8h

; C:\USERS\SSIMONE\DOCUMENTS\GITHUB\BOBINADORA\CODIGO\ALTERNATIVE CODE.PBP	00037	lcdout $fe,1,"Axis" 'Primer mensaje al LCD 
	LCDOUT?C	0FEh
	LCDOUT?C	001h
	LCDOUT?C	041h
	LCDOUT?C	078h
	LCDOUT?C	069h
	LCDOUT?C	073h

; C:\USERS\SSIMONE\DOCUMENTS\GITHUB\BOBINADORA\CODIGO\ALTERNATIVE CODE.PBP	00039	ongoing = 1
	MOVE?CT	001h, _ongoing

; C:\USERS\SSIMONE\DOCUMENTS\GITHUB\BOBINADORA\CODIGO\ALTERNATIVE CODE.PBP	00040	conteo = 65530
	MOVE?CW	0FFFAh, _conteo

; C:\USERS\SSIMONE\DOCUMENTS\GITHUB\BOBINADORA\CODIGO\ALTERNATIVE CODE.PBP	00041	Write 1,ongoing       
	WRITEADDRESS?C	001h
	WRITE?T	_ongoing

; C:\USERS\SSIMONE\DOCUMENTS\GITHUB\BOBINADORA\CODIGO\ALTERNATIVE CODE.PBP	00042	write 2,conteo.byte0
	WRITEADDRESS?C	002h
	WRITE?B	_conteo??BYTE0

; C:\USERS\SSIMONE\DOCUMENTS\GITHUB\BOBINADORA\CODIGO\ALTERNATIVE CODE.PBP	00043	write 3,conteo.byte1
	WRITEADDRESS?C	003h
	WRITE?B	_conteo??BYTE1

; C:\USERS\SSIMONE\DOCUMENTS\GITHUB\BOBINADORA\CODIGO\ALTERNATIVE CODE.PBP	00044	Pause 500
	PAUSE?C	001F4h

; C:\USERS\SSIMONE\DOCUMENTS\GITHUB\BOBINADORA\CODIGO\ALTERNATIVE CODE.PBP	00046	test_ongoing:

	LABEL?L	_test_ongoing	

; C:\USERS\SSIMONE\DOCUMENTS\GITHUB\BOBINADORA\CODIGO\ALTERNATIVE CODE.PBP	00047	read 1,ongoing 'leemos la eeprom. El resultado va a la variable 'ongoing'
	READADDRESS?C	001h
	READ?T	_ongoing

; C:\USERS\SSIMONE\DOCUMENTS\GITHUB\BOBINADORA\CODIGO\ALTERNATIVE CODE.PBP	00048	Branch ongoing, [no_ongoing_job,ongoing_job]
	BRANCH?TCL	_ongoing, 002h, L00001
	BRGOTO?L	_no_ongoing_job
	BRGOTO?L	_ongoing_job

	LABEL?L	L00001	

; C:\USERS\SSIMONE\DOCUMENTS\GITHUB\BOBINADORA\CODIGO\ALTERNATIVE CODE.PBP	00050	no_ongoing_job: 'Rutina que se ejecuta si no hay trabajo pendiente

	LABEL?L	_no_ongoing_job	

; C:\USERS\SSIMONE\DOCUMENTS\GITHUB\BOBINADORA\CODIGO\ALTERNATIVE CODE.PBP	00052	FOr flash_lcd = 1 to 4
	MOVE?CB	001h, _flash_lcd
	LABEL?L	L00002	
	CMPGT?BCL	_flash_lcd, 004h, L00003

; C:\USERS\SSIMONE\DOCUMENTS\GITHUB\BOBINADORA\CODIGO\ALTERNATIVE CODE.PBP	00053	lcdout $fe,1,"Starting new Job"
	LCDOUT?C	0FEh
	LCDOUT?C	001h
	LCDOUT?C	053h
	LCDOUT?C	074h
	LCDOUT?C	061h
	LCDOUT?C	072h
	LCDOUT?C	074h
	LCDOUT?C	069h
	LCDOUT?C	06Eh
	LCDOUT?C	067h
	LCDOUT?C	020h
	LCDOUT?C	06Eh
	LCDOUT?C	065h
	LCDOUT?C	077h
	LCDOUT?C	020h
	LCDOUT?C	04Ah
	LCDOUT?C	06Fh
	LCDOUT?C	062h

; C:\USERS\SSIMONE\DOCUMENTS\GITHUB\BOBINADORA\CODIGO\ALTERNATIVE CODE.PBP	00054	pause 100
	PAUSE?C	064h

; C:\USERS\SSIMONE\DOCUMENTS\GITHUB\BOBINADORA\CODIGO\ALTERNATIVE CODE.PBP	00055	lcdout $fe,1
	LCDOUT?C	0FEh
	LCDOUT?C	001h

; C:\USERS\SSIMONE\DOCUMENTS\GITHUB\BOBINADORA\CODIGO\ALTERNATIVE CODE.PBP	00056	Pause 100
	PAUSE?C	064h

; C:\USERS\SSIMONE\DOCUMENTS\GITHUB\BOBINADORA\CODIGO\ALTERNATIVE CODE.PBP	00057	NExt
	NEXT?BCL	_flash_lcd, 001h, L00002
	LABEL?L	L00003	

; C:\USERS\SSIMONE\DOCUMENTS\GITHUB\BOBINADORA\CODIGO\ALTERNATIVE CODE.PBP	00058	lcdout $fe,1,"Press start"
	LCDOUT?C	0FEh
	LCDOUT?C	001h
	LCDOUT?C	050h
	LCDOUT?C	072h
	LCDOUT?C	065h
	LCDOUT?C	073h
	LCDOUT?C	073h
	LCDOUT?C	020h
	LCDOUT?C	073h
	LCDOUT?C	074h
	LCDOUT?C	061h
	LCDOUT?C	072h
	LCDOUT?C	074h

; C:\USERS\SSIMONE\DOCUMENTS\GITHUB\BOBINADORA\CODIGO\ALTERNATIVE CODE.PBP	00059	Conteo=0   'Reseteamos el conteo a cero por las dudas
	MOVE?CW	000h, _conteo

; C:\USERS\SSIMONE\DOCUMENTS\GITHUB\BOBINADORA\CODIGO\ALTERNATIVE CODE.PBP	00062	listen_start_pin:       'testeamos el pin de entrada para saber cuando hay que arrancar

	LABEL?L	_listen_start_pin	

; C:\USERS\SSIMONE\DOCUMENTS\GITHUB\BOBINADORA\CODIGO\ALTERNATIVE CODE.PBP	00063	if start=1 then job
	CMPEQ?TCL	_start, 001h, _job

; C:\USERS\SSIMONE\DOCUMENTS\GITHUB\BOBINADORA\CODIGO\ALTERNATIVE CODE.PBP	00064	pause 50      
	PAUSE?C	032h

; C:\USERS\SSIMONE\DOCUMENTS\GITHUB\BOBINADORA\CODIGO\ALTERNATIVE CODE.PBP	00065	goto listen_start_pin  'encierra esto en un loop hasta que haya una entrada. 
	GOTO?L	_listen_start_pin

; C:\USERS\SSIMONE\DOCUMENTS\GITHUB\BOBINADORA\CODIGO\ALTERNATIVE CODE.PBP	00067	job:

	LABEL?L	_job	

; C:\USERS\SSIMONE\DOCUMENTS\GITHUB\BOBINADORA\CODIGO\ALTERNATIVE CODE.PBP	00068	high relay  'Mandamos un pulso para prender el relay
	HIGH?T	_relay

; C:\USERS\SSIMONE\DOCUMENTS\GITHUB\BOBINADORA\CODIGO\ALTERNATIVE CODE.PBP	00069	ongoing=1
	MOVE?CT	001h, _ongoing

; C:\USERS\SSIMONE\DOCUMENTS\GITHUB\BOBINADORA\CODIGO\ALTERNATIVE CODE.PBP	00070	write 1,ongoing 'Avisamos que hay un trabajo en progreso
	WRITEADDRESS?C	001h
	WRITE?T	_ongoing

; C:\USERS\SSIMONE\DOCUMENTS\GITHUB\BOBINADORA\CODIGO\ALTERNATIVE CODE.PBP	00071	lcdout $FE,1, "Job in Progress"
	LCDOUT?C	0FEh
	LCDOUT?C	001h
	LCDOUT?C	04Ah
	LCDOUT?C	06Fh
	LCDOUT?C	062h
	LCDOUT?C	020h
	LCDOUT?C	069h
	LCDOUT?C	06Eh
	LCDOUT?C	020h
	LCDOUT?C	050h
	LCDOUT?C	072h
	LCDOUT?C	06Fh
	LCDOUT?C	067h
	LCDOUT?C	072h
	LCDOUT?C	065h
	LCDOUT?C	073h
	LCDOUT?C	073h

; C:\USERS\SSIMONE\DOCUMENTS\GITHUB\BOBINADORA\CODIGO\ALTERNATIVE CODE.PBP	00072	lcdout $FE,$C5,DEC conteo,  " turns"               
	LCDOUT?C	0FEh
	LCDOUT?C	0C5h
	LCDOUTCOUNT?C	000h
	LCDOUTNUM?W	_conteo
	LCDOUTDEC?	
	LCDOUT?C	020h
	LCDOUT?C	074h
	LCDOUT?C	075h
	LCDOUT?C	072h
	LCDOUT?C	06Eh
	LCDOUT?C	073h

; C:\USERS\SSIMONE\DOCUMENTS\GITHUB\BOBINADORA\CODIGO\ALTERNATIVE CODE.PBP	00074	watch_pulses:

	LABEL?L	_watch_pulses	

; C:\USERS\SSIMONE\DOCUMENTS\GITHUB\BOBINADORA\CODIGO\ALTERNATIVE CODE.PBP	00075	if pulsos=1 then 
	CMPNE?TCL	_pulsos, 001h, L00004

; C:\USERS\SSIMONE\DOCUMENTS\GITHUB\BOBINADORA\CODIGO\ALTERNATIVE CODE.PBP	00076	gosub sumar
	GOSUB?L	_sumar

; C:\USERS\SSIMONE\DOCUMENTS\GITHUB\BOBINADORA\CODIGO\ALTERNATIVE CODE.PBP	00077	endif
	LABEL?L	L00004	

; C:\USERS\SSIMONE\DOCUMENTS\GITHUB\BOBINADORA\CODIGO\ALTERNATIVE CODE.PBP	00078	if pausa=1 then 
	CMPNE?TCL	_pausa, 001h, L00006

; C:\USERS\SSIMONE\DOCUMENTS\GITHUB\BOBINADORA\CODIGO\ALTERNATIVE CODE.PBP	00079	gosub pausar
	GOSUB?L	_pausar

; C:\USERS\SSIMONE\DOCUMENTS\GITHUB\BOBINADORA\CODIGO\ALTERNATIVE CODE.PBP	00080	endif
	LABEL?L	L00006	

; C:\USERS\SSIMONE\DOCUMENTS\GITHUB\BOBINADORA\CODIGO\ALTERNATIVE CODE.PBP	00081	if parar=1 then 
	CMPNE?TCL	_parar, 001h, L00008

; C:\USERS\SSIMONE\DOCUMENTS\GITHUB\BOBINADORA\CODIGO\ALTERNATIVE CODE.PBP	00082	gosub stoppear
	GOSUB?L	_stoppear

; C:\USERS\SSIMONE\DOCUMENTS\GITHUB\BOBINADORA\CODIGO\ALTERNATIVE CODE.PBP	00083	endif
	LABEL?L	L00008	

; C:\USERS\SSIMONE\DOCUMENTS\GITHUB\BOBINADORA\CODIGO\ALTERNATIVE CODE.PBP	00084	goto watch_pulses 'encierra hasta que haya un input
	GOTO?L	_watch_pulses

; C:\USERS\SSIMONE\DOCUMENTS\GITHUB\BOBINADORA\CODIGO\ALTERNATIVE CODE.PBP	00086	sumar:

	LABEL?L	_sumar	

; C:\USERS\SSIMONE\DOCUMENTS\GITHUB\BOBINADORA\CODIGO\ALTERNATIVE CODE.PBP	00087	pause 100
	PAUSE?C	064h

; C:\USERS\SSIMONE\DOCUMENTS\GITHUB\BOBINADORA\CODIGO\ALTERNATIVE CODE.PBP	00088	conteo=conteo+1
	ADD?WCW	_conteo, 001h, _conteo

; C:\USERS\SSIMONE\DOCUMENTS\GITHUB\BOBINADORA\CODIGO\ALTERNATIVE CODE.PBP	00089	write 2,conteo.byte0
	WRITEADDRESS?C	002h
	WRITE?B	_conteo??BYTE0

; C:\USERS\SSIMONE\DOCUMENTS\GITHUB\BOBINADORA\CODIGO\ALTERNATIVE CODE.PBP	00090	Write 3,conteo.byte1
	WRITEADDRESS?C	003h
	WRITE?B	_conteo??BYTE1

; C:\USERS\SSIMONE\DOCUMENTS\GITHUB\BOBINADORA\CODIGO\ALTERNATIVE CODE.PBP	00091	lcdout $FE,$C5,DEC conteo,  " turns"
	LCDOUT?C	0FEh
	LCDOUT?C	0C5h
	LCDOUTCOUNT?C	000h
	LCDOUTNUM?W	_conteo
	LCDOUTDEC?	
	LCDOUT?C	020h
	LCDOUT?C	074h
	LCDOUT?C	075h
	LCDOUT?C	072h
	LCDOUT?C	06Eh
	LCDOUT?C	073h

; C:\USERS\SSIMONE\DOCUMENTS\GITHUB\BOBINADORA\CODIGO\ALTERNATIVE CODE.PBP	00092	return
	RETURN?	

; C:\USERS\SSIMONE\DOCUMENTS\GITHUB\BOBINADORA\CODIGO\ALTERNATIVE CODE.PBP	00094	pausar:

	LABEL?L	_pausar	

; C:\USERS\SSIMONE\DOCUMENTS\GITHUB\BOBINADORA\CODIGO\ALTERNATIVE CODE.PBP	00095	Low relay
	LOW?T	_relay

; C:\USERS\SSIMONE\DOCUMENTS\GITHUB\BOBINADORA\CODIGO\ALTERNATIVE CODE.PBP	00096	lcdout $FE,$1, "Work Paused"
	LCDOUT?C	0FEh
	LCDOUT?C	001h
	LCDOUT?C	057h
	LCDOUT?C	06Fh
	LCDOUT?C	072h
	LCDOUT?C	06Bh
	LCDOUT?C	020h
	LCDOUT?C	050h
	LCDOUT?C	061h
	LCDOUT?C	075h
	LCDOUT?C	073h
	LCDOUT?C	065h
	LCDOUT?C	064h

; C:\USERS\SSIMONE\DOCUMENTS\GITHUB\BOBINADORA\CODIGO\ALTERNATIVE CODE.PBP	00097	lcdout $FE,$C0, "Press start"
	LCDOUT?C	0FEh
	LCDOUT?C	0C0h
	LCDOUT?C	050h
	LCDOUT?C	072h
	LCDOUT?C	065h
	LCDOUT?C	073h
	LCDOUT?C	073h
	LCDOUT?C	020h
	LCDOUT?C	073h
	LCDOUT?C	074h
	LCDOUT?C	061h
	LCDOUT?C	072h
	LCDOUT?C	074h

; C:\USERS\SSIMONE\DOCUMENTS\GITHUB\BOBINADORA\CODIGO\ALTERNATIVE CODE.PBP	00100	write 2,conteo.byte0
	WRITEADDRESS?C	002h
	WRITE?B	_conteo??BYTE0

; C:\USERS\SSIMONE\DOCUMENTS\GITHUB\BOBINADORA\CODIGO\ALTERNATIVE CODE.PBP	00101	Write 3,conteo.byte1
	WRITEADDRESS?C	003h
	WRITE?B	_conteo??BYTE1

; C:\USERS\SSIMONE\DOCUMENTS\GITHUB\BOBINADORA\CODIGO\ALTERNATIVE CODE.PBP	00103	Pause_loop:

	LABEL?L	_Pause_loop	

; C:\USERS\SSIMONE\DOCUMENTS\GITHUB\BOBINADORA\CODIGO\ALTERNATIVE CODE.PBP	00104	if start=1 then goto resume_job
	CMPNE?TCL	_start, 001h, L00010
	GOTO?L	_resume_job
	LABEL?L	L00010	

; C:\USERS\SSIMONE\DOCUMENTS\GITHUB\BOBINADORA\CODIGO\ALTERNATIVE CODE.PBP	00105	goto pause_loop 
	GOTO?L	_Pause_loop

; C:\USERS\SSIMONE\DOCUMENTS\GITHUB\BOBINADORA\CODIGO\ALTERNATIVE CODE.PBP	00107	Resume_job:

	LABEL?L	_resume_job	

; C:\USERS\SSIMONE\DOCUMENTS\GITHUB\BOBINADORA\CODIGO\ALTERNATIVE CODE.PBP	00108	pause 50
	PAUSE?C	032h

; C:\USERS\SSIMONE\DOCUMENTS\GITHUB\BOBINADORA\CODIGO\ALTERNATIVE CODE.PBP	00109	flash_lcd = 0 
	MOVE?CB	000h, _flash_lcd

; C:\USERS\SSIMONE\DOCUMENTS\GITHUB\BOBINADORA\CODIGO\ALTERNATIVE CODE.PBP	00110	for flash_lcd = 1 to 2 
	MOVE?CB	001h, _flash_lcd
	LABEL?L	L00012	
	CMPGT?BCL	_flash_lcd, 002h, L00013

; C:\USERS\SSIMONE\DOCUMENTS\GITHUB\BOBINADORA\CODIGO\ALTERNATIVE CODE.PBP	00111	lcdout $fe,1,"Resuming job"
	LCDOUT?C	0FEh
	LCDOUT?C	001h
	LCDOUT?C	052h
	LCDOUT?C	065h
	LCDOUT?C	073h
	LCDOUT?C	075h
	LCDOUT?C	06Dh
	LCDOUT?C	069h
	LCDOUT?C	06Eh
	LCDOUT?C	067h
	LCDOUT?C	020h
	LCDOUT?C	06Ah
	LCDOUT?C	06Fh
	LCDOUT?C	062h

; C:\USERS\SSIMONE\DOCUMENTS\GITHUB\BOBINADORA\CODIGO\ALTERNATIVE CODE.PBP	00112	pause 100
	PAUSE?C	064h

; C:\USERS\SSIMONE\DOCUMENTS\GITHUB\BOBINADORA\CODIGO\ALTERNATIVE CODE.PBP	00113	lcdout $fe,1
	LCDOUT?C	0FEh
	LCDOUT?C	001h

; C:\USERS\SSIMONE\DOCUMENTS\GITHUB\BOBINADORA\CODIGO\ALTERNATIVE CODE.PBP	00114	pause 100
	PAUSE?C	064h

; C:\USERS\SSIMONE\DOCUMENTS\GITHUB\BOBINADORA\CODIGO\ALTERNATIVE CODE.PBP	00115	next
	NEXT?BCL	_flash_lcd, 001h, L00012
	LABEL?L	L00013	

; C:\USERS\SSIMONE\DOCUMENTS\GITHUB\BOBINADORA\CODIGO\ALTERNATIVE CODE.PBP	00116	goto job
	GOTO?L	_job

; C:\USERS\SSIMONE\DOCUMENTS\GITHUB\BOBINADORA\CODIGO\ALTERNATIVE CODE.PBP	00118	stoppear: 

	LABEL?L	_stoppear	

; C:\USERS\SSIMONE\DOCUMENTS\GITHUB\BOBINADORA\CODIGO\ALTERNATIVE CODE.PBP	00119	Pause 100
	PAUSE?C	064h

; C:\USERS\SSIMONE\DOCUMENTS\GITHUB\BOBINADORA\CODIGO\ALTERNATIVE CODE.PBP	00120	low relay
	LOW?T	_relay

; C:\USERS\SSIMONE\DOCUMENTS\GITHUB\BOBINADORA\CODIGO\ALTERNATIVE CODE.PBP	00121	if stopped=1 then goto stop_loop
	CMPNE?TCL	_stopped, 001h, L00014
	GOTO?L	_stop_loop
	LABEL?L	L00014	

; C:\USERS\SSIMONE\DOCUMENTS\GITHUB\BOBINADORA\CODIGO\ALTERNATIVE CODE.PBP	00122	stopped=1
	MOVE?CT	001h, _stopped

; C:\USERS\SSIMONE\DOCUMENTS\GITHUB\BOBINADORA\CODIGO\ALTERNATIVE CODE.PBP	00123	Lcdout $fe,1,"Cancel?"
	LCDOUT?C	0FEh
	LCDOUT?C	001h
	LCDOUT?C	043h
	LCDOUT?C	061h
	LCDOUT?C	06Eh
	LCDOUT?C	063h
	LCDOUT?C	065h
	LCDOUT?C	06Ch
	LCDOUT?C	03Fh

; C:\USERS\SSIMONE\DOCUMENTS\GITHUB\BOBINADORA\CODIGO\ALTERNATIVE CODE.PBP	00124	LCDout $fe,$C0, "Stop to confirm"
	LCDOUT?C	0FEh
	LCDOUT?C	0C0h
	LCDOUT?C	053h
	LCDOUT?C	074h
	LCDOUT?C	06Fh
	LCDOUT?C	070h
	LCDOUT?C	020h
	LCDOUT?C	074h
	LCDOUT?C	06Fh
	LCDOUT?C	020h
	LCDOUT?C	063h
	LCDOUT?C	06Fh
	LCDOUT?C	06Eh
	LCDOUT?C	066h
	LCDOUT?C	069h
	LCDOUT?C	072h
	LCDOUT?C	06Dh

; C:\USERS\SSIMONE\DOCUMENTS\GITHUB\BOBINADORA\CODIGO\ALTERNATIVE CODE.PBP	00126	Stop_loop: 

	LABEL?L	_stop_loop	

; C:\USERS\SSIMONE\DOCUMENTS\GITHUB\BOBINADORA\CODIGO\ALTERNATIVE CODE.PBP	00127	if parar=1 then goto stop_sequence
	CMPNE?TCL	_parar, 001h, L00016
	GOTO?L	_stop_sequence
	LABEL?L	L00016	

; C:\USERS\SSIMONE\DOCUMENTS\GITHUB\BOBINADORA\CODIGO\ALTERNATIVE CODE.PBP	00128	goto stop_loop
	GOTO?L	_stop_loop

; C:\USERS\SSIMONE\DOCUMENTS\GITHUB\BOBINADORA\CODIGO\ALTERNATIVE CODE.PBP	00130	Stop_sequence:     'TO DO: Revisar esta rutina

	LABEL?L	_stop_sequence	

; C:\USERS\SSIMONE\DOCUMENTS\GITHUB\BOBINADORA\CODIGO\ALTERNATIVE CODE.PBP	00131	Pause 100
	PAUSE?C	064h

; C:\USERS\SSIMONE\DOCUMENTS\GITHUB\BOBINADORA\CODIGO\ALTERNATIVE CODE.PBP	00132	lcdout $fe,1, "Job stopped"
	LCDOUT?C	0FEh
	LCDOUT?C	001h
	LCDOUT?C	04Ah
	LCDOUT?C	06Fh
	LCDOUT?C	062h
	LCDOUT?C	020h
	LCDOUT?C	073h
	LCDOUT?C	074h
	LCDOUT?C	06Fh
	LCDOUT?C	070h
	LCDOUT?C	070h
	LCDOUT?C	065h
	LCDOUT?C	064h

; C:\USERS\SSIMONE\DOCUMENTS\GITHUB\BOBINADORA\CODIGO\ALTERNATIVE CODE.PBP	00133	LCDout $fe,$C0, "Press Start"
	LCDOUT?C	0FEh
	LCDOUT?C	0C0h
	LCDOUT?C	050h
	LCDOUT?C	072h
	LCDOUT?C	065h
	LCDOUT?C	073h
	LCDOUT?C	073h
	LCDOUT?C	020h
	LCDOUT?C	053h
	LCDOUT?C	074h
	LCDOUT?C	061h
	LCDOUT?C	072h
	LCDOUT?C	074h

; C:\USERS\SSIMONE\DOCUMENTS\GITHUB\BOBINADORA\CODIGO\ALTERNATIVE CODE.PBP	00134	conteo = 0 
	MOVE?CW	000h, _conteo

; C:\USERS\SSIMONE\DOCUMENTS\GITHUB\BOBINADORA\CODIGO\ALTERNATIVE CODE.PBP	00135	ongoing = 0 
	MOVE?CT	000h, _ongoing

; C:\USERS\SSIMONE\DOCUMENTS\GITHUB\BOBINADORA\CODIGO\ALTERNATIVE CODE.PBP	00136	Write 1,ongoing
	WRITEADDRESS?C	001h
	WRITE?T	_ongoing

; C:\USERS\SSIMONE\DOCUMENTS\GITHUB\BOBINADORA\CODIGO\ALTERNATIVE CODE.PBP	00137	write 2,conteo.byte0
	WRITEADDRESS?C	002h
	WRITE?B	_conteo??BYTE0

; C:\USERS\SSIMONE\DOCUMENTS\GITHUB\BOBINADORA\CODIGO\ALTERNATIVE CODE.PBP	00138	Write 3,conteo.byte1
	WRITEADDRESS?C	003h
	WRITE?B	_conteo??BYTE1

; C:\USERS\SSIMONE\DOCUMENTS\GITHUB\BOBINADORA\CODIGO\ALTERNATIVE CODE.PBP	00140	restart_button:

	LABEL?L	_restart_button	

; C:\USERS\SSIMONE\DOCUMENTS\GITHUB\BOBINADORA\CODIGO\ALTERNATIVE CODE.PBP	00141	if start=1 then goto test_ongoing
	CMPNE?TCL	_start, 001h, L00018
	GOTO?L	_test_ongoing
	LABEL?L	L00018	

; C:\USERS\SSIMONE\DOCUMENTS\GITHUB\BOBINADORA\CODIGO\ALTERNATIVE CODE.PBP	00142	pause 50
	PAUSE?C	032h

; C:\USERS\SSIMONE\DOCUMENTS\GITHUB\BOBINADORA\CODIGO\ALTERNATIVE CODE.PBP	00143	goto restart_button ' Encierra hasta que haya un loop
	GOTO?L	_restart_button

; C:\USERS\SSIMONE\DOCUMENTS\GITHUB\BOBINADORA\CODIGO\ALTERNATIVE CODE.PBP	00145	ongoing_job: 'si esta rutina se ejecuta si hay trabajo pendiente. 

	LABEL?L	_ongoing_job	

; C:\USERS\SSIMONE\DOCUMENTS\GITHUB\BOBINADORA\CODIGO\ALTERNATIVE CODE.PBP	00147	print_warning:

	LABEL?L	_print_warning	

; C:\USERS\SSIMONE\DOCUMENTS\GITHUB\BOBINADORA\CODIGO\ALTERNATIVE CODE.PBP	00148	lcdout $FE,1, "Pending job"
	LCDOUT?C	0FEh
	LCDOUT?C	001h
	LCDOUT?C	050h
	LCDOUT?C	065h
	LCDOUT?C	06Eh
	LCDOUT?C	064h
	LCDOUT?C	069h
	LCDOUT?C	06Eh
	LCDOUT?C	067h
	LCDOUT?C	020h
	LCDOUT?C	06Ah
	LCDOUT?C	06Fh
	LCDOUT?C	062h

; C:\USERS\SSIMONE\DOCUMENTS\GITHUB\BOBINADORA\CODIGO\ALTERNATIVE CODE.PBP	00149	lcdout $FE,$C5, "Continue?"
	LCDOUT?C	0FEh
	LCDOUT?C	0C5h
	LCDOUT?C	043h
	LCDOUT?C	06Fh
	LCDOUT?C	06Eh
	LCDOUT?C	074h
	LCDOUT?C	069h
	LCDOUT?C	06Eh
	LCDOUT?C	075h
	LCDOUT?C	065h
	LCDOUT?C	03Fh

; C:\USERS\SSIMONE\DOCUMENTS\GITHUB\BOBINADORA\CODIGO\ALTERNATIVE CODE.PBP	00151	check_resume:

	LABEL?L	_check_resume	

; C:\USERS\SSIMONE\DOCUMENTS\GITHUB\BOBINADORA\CODIGO\ALTERNATIVE CODE.PBP	00152	if start=1 then 
	CMPNE?TCL	_start, 001h, L00020

; C:\USERS\SSIMONE\DOCUMENTS\GITHUB\BOBINADORA\CODIGO\ALTERNATIVE CODE.PBP	00153	gosub resume_sequence
	GOSUB?L	_resume_sequence

; C:\USERS\SSIMONE\DOCUMENTS\GITHUB\BOBINADORA\CODIGO\ALTERNATIVE CODE.PBP	00154	endif
	LABEL?L	L00020	

; C:\USERS\SSIMONE\DOCUMENTS\GITHUB\BOBINADORA\CODIGO\ALTERNATIVE CODE.PBP	00155	if parar=1 then 
	CMPNE?TCL	_parar, 001h, L00022

; C:\USERS\SSIMONE\DOCUMENTS\GITHUB\BOBINADORA\CODIGO\ALTERNATIVE CODE.PBP	00156	gosub stoppear
	GOSUB?L	_stoppear

; C:\USERS\SSIMONE\DOCUMENTS\GITHUB\BOBINADORA\CODIGO\ALTERNATIVE CODE.PBP	00157	endif
	LABEL?L	L00022	

; C:\USERS\SSIMONE\DOCUMENTS\GITHUB\BOBINADORA\CODIGO\ALTERNATIVE CODE.PBP	00158	goto check_resume:
	GOTO?L	_check_resume

; C:\USERS\SSIMONE\DOCUMENTS\GITHUB\BOBINADORA\CODIGO\ALTERNATIVE CODE.PBP	00160	resume_sequence: 

	LABEL?L	_resume_sequence	

; C:\USERS\SSIMONE\DOCUMENTS\GITHUB\BOBINADORA\CODIGO\ALTERNATIVE CODE.PBP	00161	flash_lcd = 0
	MOVE?CB	000h, _flash_lcd

; C:\USERS\SSIMONE\DOCUMENTS\GITHUB\BOBINADORA\CODIGO\ALTERNATIVE CODE.PBP	00162	FOr flash_lcd = 1 to 4
	MOVE?CB	001h, _flash_lcd
	LABEL?L	L00024	
	CMPGT?BCL	_flash_lcd, 004h, L00025

; C:\USERS\SSIMONE\DOCUMENTS\GITHUB\BOBINADORA\CODIGO\ALTERNATIVE CODE.PBP	00163	lcdout $fe,1,"Resuming Job"
	LCDOUT?C	0FEh
	LCDOUT?C	001h
	LCDOUT?C	052h
	LCDOUT?C	065h
	LCDOUT?C	073h
	LCDOUT?C	075h
	LCDOUT?C	06Dh
	LCDOUT?C	069h
	LCDOUT?C	06Eh
	LCDOUT?C	067h
	LCDOUT?C	020h
	LCDOUT?C	04Ah
	LCDOUT?C	06Fh
	LCDOUT?C	062h

; C:\USERS\SSIMONE\DOCUMENTS\GITHUB\BOBINADORA\CODIGO\ALTERNATIVE CODE.PBP	00164	pause 100
	PAUSE?C	064h

; C:\USERS\SSIMONE\DOCUMENTS\GITHUB\BOBINADORA\CODIGO\ALTERNATIVE CODE.PBP	00165	lcdout $fe,1
	LCDOUT?C	0FEh
	LCDOUT?C	001h

; C:\USERS\SSIMONE\DOCUMENTS\GITHUB\BOBINADORA\CODIGO\ALTERNATIVE CODE.PBP	00166	Pause 100
	PAUSE?C	064h

; C:\USERS\SSIMONE\DOCUMENTS\GITHUB\BOBINADORA\CODIGO\ALTERNATIVE CODE.PBP	00167	NExt
	NEXT?BCL	_flash_lcd, 001h, L00024
	LABEL?L	L00025	

; C:\USERS\SSIMONE\DOCUMENTS\GITHUB\BOBINADORA\CODIGO\ALTERNATIVE CODE.PBP	00168	ongoing = 1
	MOVE?CT	001h, _ongoing

; C:\USERS\SSIMONE\DOCUMENTS\GITHUB\BOBINADORA\CODIGO\ALTERNATIVE CODE.PBP	00169	write 1,ongoing
	WRITEADDRESS?C	001h
	WRITE?T	_ongoing

; C:\USERS\SSIMONE\DOCUMENTS\GITHUB\BOBINADORA\CODIGO\ALTERNATIVE CODE.PBP	00170	read 2,conteo.byte0
	READADDRESS?C	002h
	READ?B	_conteo??BYTE0

; C:\USERS\SSIMONE\DOCUMENTS\GITHUB\BOBINADORA\CODIGO\ALTERNATIVE CODE.PBP	00171	read 3,conteo.byte1
	READADDRESS?C	003h
	READ?B	_conteo??BYTE1

; C:\USERS\SSIMONE\DOCUMENTS\GITHUB\BOBINADORA\CODIGO\ALTERNATIVE CODE.PBP	00172	goto job
	GOTO?L	_job

; C:\USERS\SSIMONE\DOCUMENTS\GITHUB\BOBINADORA\CODIGO\ALTERNATIVE CODE.PBP	00174	END
	END?	

	END
